## os/StarryOS/configs/board/licheerv-nano-sg2002.its
```
/dts-v1/;

/ {
    description = "StarryOS for LicheeRV Nano SG2002";
    #address-cells = <1>;

    images {
        kernel {
            description = "StarryOS kernel";
            data = /incbin/("${kernel_bin}");
            type = "kernel";
            arch = "riscv";
            os = "linux";
            compression = "none";
            load = <0x80200000>;
            entry = <0x80200000>;

            hash {
                algo = "sha256";
            };
        };
        fdt {
            description = "SG2002 device tree";
            data = /incbin/("${dtb_file}");
            type = "flat_dt";
            arch = "riscv";
            compression = "none";

            hash {
                algo = "crc32";
            };
        };
    };

    configurations {
        conf {
            description = "StarryOS SG2002";
            kernel = "kernel";
            fdt = "fdt";
        };
    };
};
```
